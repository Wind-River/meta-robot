## conf/layer.conf
```bitbake
BBPATH .= ":${LAYERDIR}"

# We have recipes-* directories, add to BBFILES
BBFILES += "${LAYERDIR}/recipes-*/*/*.bb \
	${LAYERDIR}/recipes-*/*/*.bbappend"

BBFILE_COLLECTIONS += "meta-robot"
BBFILE_PATTERN_meta-robot = "^${LAYERDIR}/"
BBFILE_PRIORITY_meta-robot = "6"

# This should only be incremented on significant changes that will
# cause compatibility issues with other layers
LAYERVERSION_meta-robot= "1"
LAYERSERIES_COMPAT_meta-robot = "thud"
LAYERDEPENDS_meta-robot = "core"
```
